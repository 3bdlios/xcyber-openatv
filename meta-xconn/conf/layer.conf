## meta-xconn/conf/layer.conf
```bitbake
BBPATH .= ":${LAYERDIR}"
BBFILES += "${LAYERDIR}/recipes-*/*/*.bb ${LAYERDIR}/recipes-*/*/*.bbappend"
BBFILE_COLLECTIONS += "xconn-layer"
BBFILE_PATTERN_xconn-layer := "^${LAYERDIR}/"
BBFILE_PRIORITY_xconn-layer = "20"
LAYERSERIES_COMPAT_xconn-layer = "wrynose blacksail"
```
